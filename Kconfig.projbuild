## Kconfig.projbuild
```kconfig
menu "AHT Sensor"

    config AHT_SDA
        int "AHT SDA (data) pin GPIO number"
        range 0 48
        default 26 if IDF_TARGET_ESP32
        default 4 if IDF_TARGET_ESP32S2
        default 5 if IDF_TARGET_ESP32C3
        default 6 if IDF_TARGET_ESP32C2
        default 2 if IDF_TARGET_ESP8266
        default 4
        help
            GPIO number for the SDA (data) pin of the AHT sensor.

    config AHT_SCL
        int "AHT SCL (clock) pin GPIO number"
        range 0 48
        default 27 if IDF_TARGET_ESP32
        default 5 if IDF_TARGET_ESP32S2
        default 6 if IDF_TARGET_ESP32C3
        default 18 if IDF_TARGET_ESP32C2
        default 14 if IDF_TARGET_ESP8266
        default 5
        help
            GPIO number for the SCL (clock) pin of the AHT sensor.

    config AHT_MAX_READ_COUNT
        int "AHT Max read count"
        range 50 300
        default 150
        help
            Set the max read count -> 50 to 300

    config AHT_RETRY_COUNT
        int "AHT Retry Count"
        default 200
        help
            Set the number of retries for an I2C interface

    config AHT_I2C_LEGACY
        bool "Use the legacy I2C driver (driver/i2c.h)"
        depends on !IDF_TARGET_ESP8266
        default n
        help
            From ESP-IDF 5.2 the library uses the new I2C driver (driver/i2c_master.h); older
            ESP-IDF versions always use the legacy one. The two drivers cannot be used together
            in one application (ESP-IDF stops at boot): turn this on when the application or
            another component uses the legacy driver - e.g. esp-homekit-sdk (esp_mfi_i2c.c).

endmenu
```
